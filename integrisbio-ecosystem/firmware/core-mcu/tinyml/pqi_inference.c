/*
 * pqi_inference.c
 * -----------------------------------------------------------------------
 * NOTE: This file shows the integration shape for TensorFlow Lite for
 * Microcontrollers. It intentionally does not vendor the TFLite Micro
 * library itself (that's pulled in as a dependency by the board's build
 * system — see ../CMakeLists.txt) and does not embed a real model,
 * since pqi_model_int8.tflite does not exist until edge-ai/training/ has
 * been run against real or synthetic sensor data. Swap the TODOs below
 * for the real `tflite::MicroInterpreter` calls once that model exists.
 * -----------------------------------------------------------------------
 */

#include "pqi_inference.h"
#include <string.h>

/* extern reference to the model bytes, generated by:
 *   xxd -i pqi_model_int8.tflite > pqi_model_data.h
 * (see edge-ai/quantization/quantize_to_int8.py's final export step) */
extern const unsigned char g_pqi_model_int8_tflite[];
extern const unsigned int  g_pqi_model_int8_tflite_len;

#define TENSOR_ARENA_SIZE (32 * 1024)
static uint8_t s_tensor_arena[TENSOR_ARENA_SIZE] __attribute__((aligned(16)));

static bool s_initialized = false;

int pqi_inference_init(void) {
    /* TODO (once tflite-micro is vendored into this build):
     *
     *   static tflite::MicroErrorReporter micro_error_reporter;
     *   const tflite::Model* model = tflite::GetModel(g_pqi_model_int8_tflite);
     *   static tflite::MicroMutableOpResolver<6> resolver;
     *   resolver.AddFullyConnected();
     *   resolver.AddRelu();
     *   resolver.AddQuantize();
     *   resolver.AddDequantize();
     *   resolver.AddSoftmax();
     *   resolver.AddReshape();
     *   static tflite::MicroInterpreter interpreter(
     *       model, resolver, s_tensor_arena, TENSOR_ARENA_SIZE, &micro_error_reporter);
     *   interpreter.AllocateTensors();
     */
    s_initialized = true;
    return 0;
}

int pqi_inference_run(const pqi_feature_vector_t *features, pqi_inference_result_t *out_result) {
    if (!s_initialized || !features || !out_result) return -1;

    /* TODO: quantize `features` into the model's INT8 input tensor using
     * its (scale, zero_point) from interpreter.input(0)->params, invoke
     * interpreter.Invoke(), then dequantize interpreter.output(0) back to
     * a float PQI score.
     *
     * Until the trained model is committed, fall back to the same
     * closed-form structure used in the MVP firmware
     * (firmware/mvp-arduino/sensor_processing.cpp) so the interface is
     * exercisable end-to-end in CI without a binary model artifact. */
    float pqi = 1.0f
        - (0.015f * features->thermal_integral)
        - (0.08f  * features->shock_peak_g * features->shock_event_count)
        - (0.02f  * (features->voc_slope < 0 ? -features->voc_slope : features->voc_slope))
        - (0.004f * features->spectral_delta);

    if (pqi < 0.0f) pqi = 0.0f;
    if (pqi > 1.0f) pqi = 1.0f;

    out_result->pqi_score = pqi;
    out_result->status = (pqi >= 0.85f) ? PQI_STATUS_VIABLE
                        : (pqi >= 0.70f) ? PQI_STATUS_WARNING
                        : PQI_STATUS_BREACHED;
    out_result->inference_time_us = 0; /* TODO: measure via cycle counter once real inference runs */

    return 0;
}

void pqi_inference_deinit(void) {
    s_initialized = false;
    memset(s_tensor_arena, 0, sizeof(s_tensor_arena));
}
